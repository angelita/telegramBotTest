#include <ESP8266WiFi.h>
#include <WiFiClientSecure.h>
#include <UniversalTelegramBot.h>
#define BOTtoken "581782459:AAGH4KJVMMSSs-aeAUNHMHNNP4zSQ1-Ygm8"//Generated by telegram bot creator
#define SensorPin A0         // humidity analog sensor


WiFiClientSecure client;
UniversalTelegramBot bot(BOTtoken, client);

String id, text;//Stores IDs and texts 
unsigned long tempo;
int sensorValue; 
String sensorString; 
const char* ssid     = "Broadcast";  // REPLACE SSID WITH YOUR OWN
const char* password = "gato12345";  // REPLACE WITH NETWORK PASSWORD

void setup()
{
   pinMode(D4, OUTPUT); //LED used for test
   pinMode(SensorPin, INPUT);
   Serial.begin(115200);
  // Connect to WiFi
  WiFi.begin(ssid, password);

  // while wifi not connected yet, print '.'
  // then after it connected, get out of the loop
  while (WiFi.status() != WL_CONNECTED) {
     delay(500);
     Serial.print(".");
  }
  //print a new line, then print WiFi connected, name and the IP address
  Serial.println("");
  Serial.println("WiFi connected");
    Serial.println(ssid);
  // Print the IP address
  Serial.println(WiFi.localIP());
}

void loop()
{
   sensorValue = analogRead(SensorPin); // humidity value
   sensorString = String(analogRead(SensorPin), DEC); // converts in text
   if (millis() - tempo > 2000)//checks every 2 seconds
   {
      connect();//check connection
      readTel();//read from telegram
      tempo = millis();//Reset time
   }
}

void connect()//connects to wifi network
{
   if (WiFi.status() != WL_CONNECTED)
   {
      WiFi.begin(ssid, password);
      delay(2000);
   }
}

void readTel() //Read from Telegram
{
   int newmsg = bot.getUpdates(bot.last_message_received + 1);

   for (int i = 0; i < newmsg; i++) // repeats for every message
   {
      id = bot.messages[i].chat_id;
      text = bot.messages[i].text;
      text.toUpperCase(); 

      if (text.indexOf("ON") > -1) //command used to turn LED on
      {
         digitalWrite(D4, 0);//LED on
         bot.sendMessage(id, "LED ON", "");//Confirmation message
         bot.sendMessage(id, sensorString);

         if(sensorValue > 800) { // CHANGE THIS VALUE FOR DIFFERENT PLANTS
           bot.sendMessage(id, "Ops, Too dry");//Bot reply
          }
          else {
             bot.sendMessage(id, "Chill out, your plant is fine");
             }
      }

      else if (text.indexOf("OFF") > -1)//If text contains word "OFF"
      {
         digitalWrite(D4, 1);
         bot.sendMessage(id, "LED OFF", "");//Confirmation message
      }

      else if (text.indexOf("START") > -1)//In case it gets the word Start
      {
         bot.sendSimpleMessage(id, id, "");//Sends message with user ID
      }

      else//Error message for unknown commands
      {
         bot.sendSimpleMessage(id, "Invalid Command", "");
      }
   }

}
